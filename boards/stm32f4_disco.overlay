// STM32F4 Discovery 设备树 overlay

#include <zephyr/dt-bindings/dma/stm32_dma.h>

/* ===== UART1 配置 =====
 * USART1, TX=PA9, RX=PA10, 115200 baud, DMA 接收
 */
&usart1 {
	pinctrl-0 = <&usart1_tx_pa9 &usart1_rx_pa10>;
	pinctrl-names = "default";
	current-speed = <115200>;
	status = "okay";

	dmas = <&dma2 7 4 (STM32_DMA_PERIPH_TX | STM32_DMA_PRIORITY_HIGH) STM32_DMA_FIFO_FULL>,
	       <&dma2 2 4 (STM32_DMA_PERIPH_RX | STM32_DMA_PRIORITY_HIGH) STM32_DMA_FIFO_FULL>;
	dma-names = "tx", "rx";
};

&dma2 {
	status = "okay";
};

