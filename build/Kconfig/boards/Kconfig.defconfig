## build/Kconfig/boards/Kconfig.defconfig
```kconfig
# Load Zephyr board defconfig descriptions.
osource "D:/Zephyr/zephyr/boards/st/stm32f4_disco/Kconfig.defconfig"
```

## build/Kconfig/boards/Kconfig.stm32f4_disco.tmp
```kconfig
# Load board Kconfig descriptions.
osource "D:/Zephyr/zephyr/boards/st/stm32f4_disco/Kconfig.stm32f4_disco"
```

## build/Kconfig/boards/Kconfig.tmp
```kconfig
# Load Zephyr board Kconfig descriptions.
osource "D:/Zephyr/zephyr/boards/st/stm32f4_disco/Kconfig"
```
